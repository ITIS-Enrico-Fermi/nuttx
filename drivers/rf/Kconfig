## drivers/rf/Kconfig
```kconfig
#
# For a description of the syntax of this configuration file,
# see the file kconfig-language.txt in the NuttX tools repository.
#

menuconfig DRIVERS_RF
	bool "RF Device Support"
	default n
	---help---
		Drivers for various RF devices

if DRIVERS_RF

config RF_DAT31R5SP
	bool "Mini-Circuits DAT-31R5-SP digital attenuator support"
	default n
	select SPI
	---help---
		Enable driver support for the Mini-Circuits DAT-31R5-SP digital
		attenuator.

config RF_RFM95
	bool "Custom SPI RFM95 Driver"
	default n
	select SPI
	---help---
		Enable SPI RFM95 Driver.

if RF_RFM95

config RF_RFM95_RESET_PIN
	int "RFM95 Reset pin number"
	default 1
	---help---
		Select your board pin connected to RST RFM95 pin.

config RF_RFM95_SPI_FREQUENCY
	int "RFM95 SPI bus frequency"
	default 9000000
	---help---
		Select your board pin connected to RST RFM95 pin.

endif # RF_RFM95

endif # DRIVERS_RF
```

## libs/libisxcamera/Kconfig
```kconfig
#
# For a description of the syntax of this configuration file,
# see the file kconfig-language.txt in the NuttX tools repository.
#

menuconfig LIBISXCAMERA
	bool "Libisxcamera utily"
	default n
	---help---
		Enable custom functions for easy camera setup

if LIBISXCAMERA

config LIBISXCAMERA_DEBUG
	bool "Libisxcamera debugging"
	default n
	---help---
		This option does nothing

endif # LIBISXCAMERA
```
